/*
 * Copyright (c) 2021 The ZMK Contributors
 *
 * SPDX-License-Identifier: MIT
 */

/dts-v1/;
#include "dogbone.dtsi"

/ {
	chosen {
		zmk,battery = &vbatt;
	};
};

/ {
	ext-power {
		compatible = "zmk,ext-power-generic";
		label = "EXT_POWER";
		control-gpios = <&gpio1 9 GPIO_ACTIVE_LOW>;
        init-delay-ms = <50>;
	};

	vbatt: vbatt {
		compatible = "zmk,battery-nrf-vddh";
		label = "BATTERY";
	};

};
