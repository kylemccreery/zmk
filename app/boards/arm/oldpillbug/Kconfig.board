## app/boards/arm/oldpillbug/Kconfig.board
```kconfig
# Copyright (c) 2022 The ZMK Contributors
# SPDX-License-Identifier: MIT

config BOARD_OLDPILLBUG
    bool "PillBug v0.1"
    depends on SOC_NRF52840_QIAA
```

## app/boards/arm/oldpillbug/Kconfig.defconfig
```kconfig
# Copyright (c) 2022 The ZMK Contributors
# SPDX-License-Identifier: MIT

if BOARD_OLDPILLBUG

config BOARD
    default "PillBug v0.1"

if USB_DEVICE_STACK

config USB_NRFX
    default y

endif # USB_DEVICE_STACK

config BT_CTLR
    default BT

config ZMK_BLE
    default y

config ZMK_USB
    default y

endif # BOARD_OLDPILLBUG
```

## app/boards/arm/sugarbug/Kconfig.board
```kconfig
# Copyright (c) 2022 The ZMK Contributors
# SPDX-License-Identifier: MIT

config BOARD_SUGARBUG
    bool "SugarBug"
    depends on SOC_NRF52840_QIAA
```

## app/boards/arm/sugarbug/Kconfig.defconfig
```kconfig
# Copyright (c) 2022 The ZMK Contributors
# SPDX-License-Identifier: MIT

if BOARD_SUGARBUG

config ZMK_KEYBOARD_NAME
    default "SugarBug"

config BT_CTLR
    default BT

config ZMK_BLE
    default y

config ZMK_USB
    default y

config I2C
	default y

if USB

config USB_NRFX
	default y

config USB_DEVICE_STACK
	default y

endif # USB

if ZMK_DISPLAY

config SSD1306
	default y

config SSD1306_REVERSE_MODE
	default y

endif # ZMK_DISPLAY

if LVGL

config LVGL_VDB_SIZE
    default 64

config LVGL_DPI
    default 148

config LVGL_BITS_PER_PIXEL
    default 1

choice LVGL_COLOR_DEPTH
    default LVGL_COLOR_DEPTH_1
endchoice

endif # LVGL

endif # BOARD_SUGARBUG
```

## app/boards/arm/sugarbug/sugarbug_defconfig
```kconfig
# Copyright (c) 2022 The ZMK Contributors
# SPDX-License-Identifier: MIT

CONFIG_SOC_SERIES_NRF52X=y
CONFIG_SOC_NRF52840_QIAA=y
CONFIG_BOARD_SUGARBUG=y

# Enable MPU
CONFIG_ARM_MPU=y

# enable GPIO
CONFIG_GPIO=y

CONFIG_USE_DT_CODE_PARTITION=y
CONFIG_BUILD_OUTPUT_UF2=y

CONFIG_MPU_ALLOW_FLASH_WRITE=y
CONFIG_NVS=y
CONFIG_SETTINGS_NVS=y
CONFIG_FLASH=y
CONFIG_FLASH_PAGE_LAYOUT=y
CONFIG_FLASH_MAP=y

# Uncomment to turn on logging, and set ZMK logging to debug output
#CONFIG_ZMK_USB_LOGGING=y
#CONFIG_I2C_LOG_LEVEL_DBG=y
#CONFIG_GPIO_LOG_LEVEL_DBG=y

# Uncomment both to enable encoder
CONFIG_EC11=y
CONFIG_EC11_TRIGGER_GLOBAL_THREAD=y

# Enable i2c
CONFIG_I2C=y
CONFIG_PINCTRL=y


CONFIG_ZMK_KSCAN_MATRIX_POLLING=y
CONFIG_GPIO_MCP230XX=y

#CONFIG_ZMK_KSCAN_MATRIX_WAIT_BEFORE_INPUTS=150
#CONFIG_ZMK_KSCAN_MATRIX_WAIT_BETWEEN_OUTPUTS=150

# OLED config
CONFIG_ZMK_DISPLAY=y
CONFIG_SSD1306=y
CONFIG_SSD1306_REVERSE_MODE=y
CONFIG_LVGL_HOR_RES_MAX=128
CONFIG_LVGL_VER_RES_MAX=64
CONFIG_LVGL_VDB_SIZE=64
CONFIG_LVGL_DPI=148
CONFIG_LVGL_BITS_PER_PIXEL=1
CONFIG_LVGL_COLOR_DEPTH_1=y

# Uncomment both to enable underglow
CONFIG_ZMK_RGB_UNDERGLOW=y
CONFIG_WS2812_STRIP=y



#########################

#CONFIG_SPI=y
#CONFIG_PINNACLE=y
#CONFIG_PINNACLE_TRIGGER_OWN_THREAD=y
#CONFIG_ZMK_MOUSE=y
#CONFIG_ZMK_SLEEP=y
#CONFIG_ZMK_IDLE_SLEEP_TIMEOUT=420000
```

## app/boards/shields/bb40/Kconfig.defconfig
```kconfig
# Copyright (c) 2022 The ZMK Contributors
# SPDX-License-Identifier: MIT

if SHIELD_BB40

config ZMK_KEYBOARD_NAME
    default "BB40"

endif
```

## app/boards/shields/bb40/Kconfig.shield
```kconfig
# Copyright (c) 2022 The ZMK Contributors
# SPDX-License-Identifier: MIT

config SHIELD_BB40
    def_bool $(shields_list_contains,bb40)
```

## app/boards/shields/bb65/Kconfig.defconfig
```kconfig
# Copyright (c) 2023 The ZMK Contributors
# SPDX-License-Identifier: MIT

if SHIELD_BB65

config ZMK_KEYBOARD_NAME
    default "BB65"

endif
```

## app/boards/shields/murphpad_view_test/Kconfig.shield
```kconfig
# Copyright (c) 2021 The ZMK Contributors
# SPDX-License-Identifier: MIT

config SHIELD_MURPHPAD_VIEW_TEST
	def_bool $(shields_list_contains,murphpad_view_test)
```

## app/boards/shields/obevt/Kconfig.shield
```kconfig
# Copyright (c) 2022 The ZMK Contributors
# SPDX-License-Identifier: MIT

config SHIELD_OBEVT
    def_bool $(shields_list_contains,obevt)
```

## app/boards/shields/puckbuddy/boards/pillbug.conf
```kconfig
# Uncomment both to enable underglow
CONFIG_ZMK_RGB_UNDERGLOW=y
CONFIG_WS2812_STRIP=y

# Uncomment to enable OLED
CONFIG_ZMK_DISPLAY=y

# Uncomment to enable Cirque trackpad
CONFIG_PINNACLE=y
CONFIG_PINNACLE_TRIGGER_OWN_THREAD=y
CONFIG_ZMK_MOUSE=y
```

## app/boards/shields/rb4x/Kconfig.defconfig
```kconfig
# Copyright (c) 2021 The ZMK Contributors
# SPDX-License-Identifier: MIT

if SHIELD_RB4X

config ZMK_KEYBOARD_NAME
	default "RB4X"

endif
```

## app/boards/shields/rb4x/Kconfig.shield
```kconfig
# Copyright (c) 2021 The ZMK Contributors
# SPDX-License-Identifier: MIT

config SHIELD_RB4X
	def_bool $(shields_list_contains,rb4x)
```

## app/boards/shields/rbf/Kconfig.defconfig
```kconfig
# Copyright (c) 2021 The ZMK Contributors
# SPDX-License-Identifier: MIT


if SHIELD_RBF

config ZMK_KEYBOARD_NAME
	default "RBF"

config ZMK_USB
    default y
	
endif
```

## app/boards/shields/rbf/Kconfig.shield
```kconfig
# Copyright (c) 2021 The ZMK Contributors
# SPDX-License-Identifier: MIT

config SHIELD_RBF
	def_bool $(shields_list_contains,rbf)
```
